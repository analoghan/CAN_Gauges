#include <SPI.h>
#include <Adafruit_GFX.h>
#include <Adafruit_SSD1306.h>
#include <mcp_can.h>
#include <i2c_t3.h>

// <--- Begin Display Defintions

#define TCAADDR 0x70
#define OLED_RESET 22
#define SSD1306_128_32

Adafruit_SSD1306 display(OLED_RESET);

// End Display Definitions --->

// <--- Begin Display Math for Gauges
int i = 0;
float rawval = 0; // Setup raw sensor value
float kpaval = 0; // Setup kPa value
float boost = 0; // Setup boost value
float barboost = 0; // Setup value for boost bar
float vac = 0; // Setup vacuum value
float peak = 0; // Setup peak value
float lambda1_raw = 0 ; // Raw Lambda Sensor Value 1
float lambda1 = 0 ; // Lambda
float afr1 = 0 ; // AFR
float lambda2_raw = 0 ; // Raw Lambda Sensor Value 2
float lambda2 = 0 ; // Lambda
float afr2 = 0 ; // AFR
float e85_raw = 0 ; // E85 Raw
float e85 = 0 ; // E85 Percentage

// End Display Math for Gauges --->

// <--- Begin Button Setup

uint8_t Switch = 7;     // the number of the pushbutton pin

volatile int gaugeselect = 0;         // Set a rolling variable to select screen display

// End Button Setup --->

// <--- Begin Boot Logo Display Definitions

unsigned long ford_logo_time = 2500;     // milliseconds for Ford logo at boot
unsigned long stang_logo_time = 5000;    // milliseconds for Mustang logo at boot
int boot_complete = 0;          // Have we done the boot logos?

// 'Ford_Logo_jpg'
const unsigned char Ford_Logo [] PROGMEM = {
  0x00, 0x00, 0x00, 0x00, 0x00, 0x00, 0x00, 0x00, 0x00, 0x00, 0x00, 0x00, 0x00, 0x00, 0x00, 0x00,
  0x00, 0x00, 0x00, 0x00, 0x00, 0x00, 0x00, 0x00, 0x00, 0x00, 0x00, 0x00, 0x00, 0x00, 0x00, 0x00,
  0x00, 0x00, 0x00, 0x00, 0x00, 0x00, 0x00, 0x00, 0x00, 0x00, 0x00, 0x00, 0x00, 0x00, 0x00, 0x00,
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  0x00, 0x00, 0x00, 0x00, 0x00, 0x00, 0x00, 0x00, 0x00, 0x00, 0x00, 0x00, 0x00, 0x00, 0x00, 0x00
};

// 'Stang_Logo_jpg'
const unsigned char Stang_Logo [] PROGMEM = {
  0x00, 0x00, 0x00, 0x00, 0x00, 0x00, 0x00, 0x00, 0x00, 0x00, 0x00, 0x00, 0x00, 0x00, 0x00, 0x00,
  0x00, 0x00, 0x00, 0x00, 0x00, 0x00, 0x00, 0x00, 0x00, 0x00, 0x00, 0x00, 0x00, 0x00, 0x00, 0x00,
  0x00, 0x00, 0x00, 0x00, 0x00, 0x00, 0x00, 0x00, 0x00, 0x00, 0x00, 0x00, 0x00, 0x00, 0x00, 0x00,
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  0x00, 0x00, 0x00, 0x00, 0x00, 0x00, 0x00, 0x00, 0x00, 0x00, 0x00, 0x00, 0x00, 0x00, 0x00, 0x00
};

// End Boot Logo Display Definitions --->

// <--- Begin CAN Bus Definitions

long unsigned int rxId;
unsigned char len = 0;
unsigned char rxBuf[8];
char msgString[128];                        // Array to store serial string

#define CAN0_INT 16                         // Set INT to pin 16
MCP_CAN CAN0(10);                           // Set CS to pin 10

// End CAN Bus Definitions --->

// <--- Begin AEMNet Calculations per AEM CAN PDF Guide

const float RPM_SCALE = .39063;
const float ENG_LOAD_SCALE = .0015259;
const float ENG_THROTTLE_SCALE = .0015259;
const float ANALOG_SCALE = .00007782;
const float O2_SCALE = .00390625;
const float SPEED_SCALE = .00390625;
const float IGN_SCALE = .35156;
const float BATT_VOLTAGE_SCALE = .0002455;
const float TPS_SCALE = .0015259;
const float MAP_SCALE = .014504;
const float FUELPRESS_SCALE = .580151;
const float OILPRESS_SCALE = .580151;
const float LAMBDATARGET_SCALE = .00390625;
const float INJDUTY_SCALE = .392157;
const float FLEXFUEL_SCALE = .392157;
const float SPARKCUT_SCALE = .39063;
const float FUELCUT_SCALE = .39063;

int8_t coolantC;
int8_t iatC;
int8_t oilC;

double MAP;
double VE;
double fuelpress;
double oilpress;
double lambdatgt;
double injpw;
double injdutycycle;
double flex;
double sparkcut;
double fuelcut;
double oilF;
double rpm;
double load;
double tps;
double coolantF;
double iatF;
double o2_a;
double o2_b;
double vehicleSpeed;
double timing;
byte gear;
double volts;

// End AEMNet Calculations per AEM CAN PDF Guide --->

// Function for TCA Multiplexer for I2C

void tcaselect(uint8_t i) {
  if (i > 7) return;

  Wire.setClock(1000000);
  Wire.beginTransmission(TCAADDR);
  Wire.write(1 << i);
  Wire.endTransmission();
}

void setup()
{
  Serial.begin(2000000);                          // Super fast because Teensy is USB anyway

  // Initialize MCP2515 running at 8MHz with a baudrate of 500kb/s in STDEXT mode to allow filters.
  if (CAN0.begin(MCP_STDEXT, CAN_500KBPS, MCP_8MHZ) == CAN_OK)
    Serial.println("MCP2515 Initialized Successfully!");
  else
    Serial.println("Error Initializing MCP2515...");


  CAN0.init_Mask(0, 1, 0x1FFFFFF0);                // Set CAN filter mask 0
  CAN0.init_Mask(1, 1, 0x1FFFFFF0);                // Set CAN filter mask 1

  CAN0.init_Filt(0, 1, 0x01F0A000);                // Filter for CAN IDs 0-F

  CAN0.setMode(MCP_NORMAL);                        // Set operation mode to normal so the MCP2515 sends acks to received data.

  pinMode(CAN0_INT, INPUT);                        // Configuring pin for /INT input
  pinMode(Switch, INPUT);                          // Configuring pin for Switch input

  attachInterrupt(Switch, button_check, FALLING);  // Interrupt for button press to select gauges

  attachInterrupt(CAN0_INT, canbus_read, FALLING); // Interrupt for CAN bus data receipt

}

// Function to intialize displays so that we can use them later

void initialize_displays()
{
  for (static int gauge_start = 0; gauge_start < 5; gauge_start++)
  {
    int tca = (gauge_start - 1);
    tcaselect(tca);
    display.begin(SSD1306_SWITCHCAPVCC);
    display.display();
    display.clearDisplay();
  }
}

// Function to display logos on boot up

void boot_logo(int gauge_id)
{
  if (boot_complete != 1)
  {
    display.display();
    display.clearDisplay();

    static unsigned long startMillis = millis();
    unsigned long currentMillis = millis();

    if (currentMillis - startMillis <= ford_logo_time)
    {
      tcaselect(gauge_id);
      display.drawBitmap(0, 0, Ford_Logo, 128, 64, WHITE);
    }
    else if ((currentMillis - startMillis > ford_logo_time) && (currentMillis - startMillis <= stang_logo_time))
    {
      tcaselect(gauge_id);
      display.drawBitmap(0, 0, Stang_Logo, 128, 64, WHITE);
    }
    else if (currentMillis - startMillis > stang_logo_time)
    {
      Serial.println("Displays booted!");
      boot_complete = 1;;
    }
  }
}

// Button check function

void button_check()
{
  //  Serial.println("Interrupted!");

  volatile int CurrentSwitch = digitalRead(Switch);

  if (CurrentSwitch == LOW)
  {
    if (gaugeselect < 2)
    {
      gaugeselect = gaugeselect + 1;
      //      Serial.println(gaugeselect);
    }
    else
    {
      gaugeselect = 0;
      //      Serial.println(gaugeselect);
    }
  }
}

// Gauge Functons - Some Test functions exist here, will add more later

void boost_gauge()
{
  int tca = 0;

  tcaselect(tca);
  boost = ((MAP * 0.04) - 14.23); // Calculate psi from raw value
  barboost = ((MAP * 0.19) - 69.45); // Calculate boost value for the bargraph
  vac = boost * -2.036020; // Used 'minus' 2.036020 so that the figure printed wont have a minus symbol in front of it

  display.setTextColor(WHITE);
  display.setTextSize(2);
  display.setCursor(5, 0);
  display.println(MAP, 0);
  display.setCursor(75, 0);
  display.println("kPa");
  display.setCursor(5, 19);
  display.println(boost, 1);
  display.setCursor(75, 19);
  display.println("PSI");
  display.drawRect(1, 38, 125, 10, WHITE); //Border of the bar chart
  display.fillRect(1, 38, barboost, 10, WHITE); //Draws the bar depending on the sensor value
  display.setTextSize(1);
  display.setCursor(20, 55);
  display.println(peak, 1); // Prints the peak value
  display.setCursor(60, 55);
  display.println("PSI Peak");
  display.display();
  display.clearDisplay();
}



void wideband_gauge_1()
{
  int tca = 1;

  tcaselect(tca);
  afr1 = (o2_a * 14.7); // Calculate AFR

  display.setTextColor(WHITE);
  display.setTextSize(2);
  display.setCursor(5, 0);
  display.println(o2_a, 2);
  display.setCursor(75, 0);
  display.println("L1");
  display.setCursor(5, 19);
  display.println(afr1, 1);
  display.setCursor(75, 19);
  display.println("AFR1");
  display.drawRect(1, 38, 125, 10, WHITE); //Border of the bar chart
  display.fillRect(1, 38, barboost, 10, WHITE); //Draws the bar depending on the sensor value
  display.setTextSize(1);
  display.setCursor(2, 55);
  display.println("Lean"); // Prints the peak value
  display.setCursor(100 , 55);
  display.println("Rich");
  display.display();
  display.clearDisplay();
}




void wideband_gauge_2()
{
  tcaselect(3);
  afr2 = (o2_b * 14.7); // Calculate
  if (boost > peak) peak = boost ; // Store new peak value in peak memory

  display.setTextColor(WHITE);
  display.setTextSize(2);
  display.setCursor(5, 0);
  display.println(o2_b, 2);
  display.setCursor(75, 0);
  display.println("L2");
  display.setCursor(5, 19);
  display.println(afr2, 1);
  display.setCursor(75, 19);
  display.println("AFR2");
  display.drawRect(1, 38, 125, 10, WHITE); //Border of the bar chart
  display.fillRect(1, 38, barboost, 10, WHITE); //Draws the bar depending on the sensor value
  display.setTextSize(1);
  display.setCursor(2, 55);
  display.println("Lean"); // Prints the peak value
  display.setCursor(100 , 55);
  display.println("Rich");
  display.display();
  display.clearDisplay();

}

void e85_gauge()
{
  tcaselect(2);
  e85_raw = flex; // Read MAP sensor raw value on analog port 0

  display.setTextColor(WHITE);
  display.setTextSize(1);
  display.setCursor(20, 1);
  display.println("Ethanol Content");
  display.setTextSize(5);
  display.setCursor(15, 20);
  display.println(e85, 0);
  display.setCursor(85, 20);
  display.println("%");
  display.display();
  display.clearDisplay();

}

// Test gauges from here on out

void test_gauge()
{
  static int test = 1;

  tcaselect(0);

  display.setTextColor(WHITE);
  display.setTextSize(1);
  display.setCursor(20, 1);
  display.println("This is a test!");
  display.println(test);
  display.display();
  display.clearDisplay();
  test++;
}

void test_gauge2()
{
  static int test = 1;

  tcaselect(1);

  display.setTextColor(WHITE);
  display.setTextSize(1);
  display.setCursor(15, 1);
  display.println("This is a test 2!");
  display.println(test);
  display.display();
  display.clearDisplay();
  test++;
}

void test_gauge3()
{
  static int test = 1;

  tcaselect(2);

  display.setTextColor(WHITE);
  display.setTextSize(1);
  display.setCursor(15, 1);
  display.println("This is a test 3!");
  display.println(test);
  display.display();
  display.clearDisplay();
  test++;
}

void boost_gauge_test_1()
{
  tcaselect(0);
  boost = ((MAP * 0.04) - 14.23); // Calculate psi from raw value
  barboost = ((MAP * 0.19) - 69.45); // Calculate boost value for the bargraph
  vac = boost * -2.036020; // Used 'minus' 2.036020 so that the figure printed wont have a minus symbol in front of it

  display.setTextColor(WHITE);
  display.setTextSize(2);
  display.setCursor(5, 0);
  display.println(MAP, 0);
  display.setCursor(75, 0);
  display.println("kPa");
  display.setCursor(5, 19);
  display.println(boost, 1);
  display.setCursor(75, 19);
  display.println("PSI");
  display.drawRect(1, 38, 125, 10, WHITE); //Border of the bar chart
  display.fillRect(1, 38, barboost, 10, WHITE); //Draws the bar depending on the sensor value
  display.setTextSize(1);
  display.setCursor(20, 55);
  display.println(peak, 1); // Prints the peak value
  display.setCursor(60, 55);
  display.println("PSI Peak");
  display.display();
  display.clearDisplay();
}

void boost_gauge_test_2()
{
  static int test = 1;

  tcaselect(1);
  boost = ((MAP * 0.04) - 14.23); // Calculate psi from raw value
  barboost = ((MAP * 0.19) - 69.45); // Calculate boost value for the bargraph
  vac = boost * -2.036020; // Used 'minus' 2.036020 so that the figure printed wont have a minus symbol in front of it
  MAP = (MAP + test);

  display.setTextColor(WHITE);
  display.setTextSize(2);
  display.setCursor(5, 0);
  display.println(MAP, 0);
  display.setCursor(75, 0);
  display.println("kPa");
  display.setCursor(5, 19);
  display.println(boost, 1);
  display.setCursor(75, 19);
  display.println("PSI");
  display.drawRect(1, 38, 125, 10, WHITE); //Border of the bar chart
  display.fillRect(1, 38, barboost, 10, WHITE); //Draws the bar depending on the sensor value
  display.setTextSize(1);
  display.setCursor(20, 55);
  display.println(peak, 1); // Prints the peak value
  display.setCursor(60, 55);
  display.println("PSI Peak");
  display.display();
  display.clearDisplay();
  test++;

}

void boost_gauge_test_3()
{
  static int test = 1;

  tcaselect(2);
  boost = ((MAP * 0.04) - 14.23); // Calculate psi from raw value
  barboost = ((MAP * 0.19) - 69.45); // Calculate boost value for the bargraph
  vac = boost * -2.036020; // Used 'minus' 2.036020 so that the figure printed wont have a minus symbol in front of it
  MAP = (MAP + test);

  display.setTextColor(WHITE);
  display.setTextSize(2);
  display.setCursor(5, 0);
  display.println(MAP, 0);
  display.setCursor(75, 0);
  display.println("kPa");
  display.setCursor(5, 19);
  display.println(boost, 1);
  display.setCursor(75, 19);
  display.println("PSI");
  display.drawRect(1, 38, 125, 10, WHITE); //Border of the bar chart
  display.fillRect(1, 38, barboost, 10, WHITE); //Draws the bar depending on the sensor value
  display.setTextSize(1);
  display.setCursor(20, 55);
  display.println(peak, 1); // Prints the peak value
  display.setCursor(60, 55);
  display.println("PSI Peak");
  display.display();
  display.clearDisplay();
  test++;

}

void boost_gauge_test_4()
{
  static int test = 1;

  tcaselect(3);
  boost = ((MAP * 0.04) - 14.23); // Calculate psi from raw value
  barboost = ((MAP * 0.19) - 69.45); // Calculate boost value for the bargraph
  vac = boost * -2.036020; // Used 'minus' 2.036020 so that the figure printed wont have a minus symbol in front of it
  MAP = (MAP + test);

  display.setTextColor(WHITE);
  display.setTextSize(2);
  display.setCursor(5, 0);
  display.println(MAP, 0);
  display.setCursor(75, 0);
  display.println("kPa");
  display.setCursor(5, 19);
  display.println(boost, 1);
  display.setCursor(75, 19);
  display.println("PSI");
  display.drawRect(1, 38, 125, 10, WHITE); //Border of the bar chart
  display.fillRect(1, 38, barboost, 10, WHITE); //Draws the bar depending on the sensor value
  display.setTextSize(1);
  display.setCursor(20, 55);
  display.println(peak, 1); // Prints the peak value
  display.setCursor(60, 55);
  display.println("PSI Peak");
  display.display();
  display.clearDisplay();
  test++;
}

// <--- Begin CAN Bus function

void canbus_read()
{
  if (!digitalRead(CAN0_INT))                        // If CAN0_INT pin is low, read receive buffer
  {
    CAN0.readMsgBuf(&rxId, &len, rxBuf);      // Read data: len = data length, buf = data byte(s)

    unsigned char canId = CAN0.getCanId();

    if (canId == 0) {
      uint16_t rawRPM = (uint16_t)rxBuf[0] << 8;
      rawRPM |= rxBuf[1];
      rpm = rawRPM * RPM_SCALE;

      uint16_t rawLoad = (uint16_t)rxBuf[2] << 8;
      rawLoad |= rxBuf[3];
      load = rawLoad * ENG_LOAD_SCALE;

      uint16_t rawTPS = (uint16_t)rxBuf[4] << 8;
      rawTPS |= rxBuf[5];
      tps = rawTPS * TPS_SCALE;

      iatC = rxBuf[6];

      iatF = ((double)iatC * 1.8) + 32;

      coolantC = rxBuf[7];

      coolantF = ((double)coolantC * 1.8) + 32;

      //            Serial.print("RPM: ");
      //            Serial.print(rpm);
      //            Serial.print("  Load: ");
      //            Serial.print(load);
      //            Serial.print("  TPS: ");
      //            Serial.print(tps);
      //            Serial.print("  IAT (C): ");
      //            Serial.print(iatC);
      //            Serial.print("  Temp (C): ");
      //            Serial.print(coolantC);
      //            Serial.println();
    }

    else if (canId == 3) {
      uint8_t rawo2_a = (uint8_t)rxBuf[0];
      o2_a = rawo2_a * O2_SCALE + 0.5;

      uint8_t rawo2_b = (uint8_t)rxBuf[1];
      o2_b = rawo2_b * O2_SCALE + 0.5;

      uint16_t rawSpeed = (uint16_t)rxBuf[2] << 8;
      rawSpeed |= rxBuf[3];
      vehicleSpeed = rawSpeed * SPEED_SCALE;

      gear = rxBuf[4];

      uint8_t rawign = (uint8_t)rxBuf[5];
      timing = rawign * IGN_SCALE - 17;

      uint16_t rawVolts = (uint16_t)rxBuf[6] << 8;
      rawVolts |= rxBuf[7];
      volts = rawVolts * BATT_VOLTAGE_SCALE;

      //            Serial.print("WBO2 1: ");
      //            Serial.print(o2_a);
      //            Serial.print("  WBO2 1: ");
      //            Serial.print(o2_b);
      //            Serial.print("  Speed: ");
      //            Serial.print(vehicleSpeed);
      //            Serial.print("  Gear: ");
      //            Serial.print(gear);
      //            Serial.print("  Timing *: ");
      //            Serial.print(timing);
      //            Serial.print("  Volts: ");
      //            Serial.print(volts);
      //            Serial.println();
    }

    else if (canId == 4) {
      uint16_t rawMAP = (uint16_t)rxBuf[0] << 8;
      rawMAP |= rxBuf[1];
      MAP = rawMAP * MAP_SCALE;

      uint8_t rawVE = (uint8_t)rxBuf[2];
      VE = rawVE;

      uint8_t rawfuelpress = (uint8_t)rxBuf[3];
      fuelpress = rawfuelpress * FUELPRESS_SCALE;

      uint8_t rawoilpress = (uint8_t)rxBuf[4];
      oilpress = rawoilpress * OILPRESS_SCALE;

      uint8_t rawlambda = (uint8_t)rxBuf[5];
      lambdatgt = rawlambda * LAMBDATARGET_SCALE + 0.5;

      //            Serial.print("MAP: ");
      //            Serial.print(MAP);
      //            Serial.print("  VE: ");
      //            Serial.print(VE);
      //            Serial.print("  Fuel Pressure: ");
      //            Serial.print(fuelpress);
      //            Serial.print("  Oil Pressure: ");
      //            Serial.print(oilpress);
      //            Serial.print("  Lambda Target: ");
      //            Serial.print(lambdatgt);
      //            Serial.println();
    }

    else if (canId == 6) {
      uint8_t rawinjpw = (uint8_t)rxBuf[0];
      injpw = rawinjpw * 0.1;

      uint8_t rawinjdc = (uint8_t)rxBuf[2];
      injdutycycle = rawinjdc * INJDUTY_SCALE;

      //            Serial.print("Injector PW: ");
      //            Serial.print(injpw);
      //            Serial.print("  Injector Duty: ");
      //            Serial.print(injdutycycle);
      //            Serial.println();
    }

    else if (canId == 7) {
      uint8_t rawflex = (uint8_t)rxBuf[4];
      flex = rawflex * FLEXFUEL_SCALE;

      uint8_t rawoilC = (uint8_t)rxBuf[6];
      oilC = rawoilC - 50;

      oilF = ((double)oilC * 1.8) + 32;

      //            Serial.print("E85 %: ");
      //            Serial.print(flex);
      //            Serial.print("   Oil Temp: ");
      //            Serial.print(oilF);
      //            Serial.println();
    }

    else if (canId == 8) {
      uint16_t rawsparkcut = (uint16_t)rxBuf[1] << 8;
      rawsparkcut |= rxBuf[2];
      sparkcut = rawsparkcut * SPARKCUT_SCALE;

      uint16_t rawfuelcut = (uint16_t)rxBuf[3] << 8;
      rawfuelcut |= rxBuf[4];
      fuelcut = rawfuelcut * FUELCUT_SCALE;

      //            Serial.print("Spark Cut RPM: ");
      //            Serial.print(sparkcut);
      //            Serial.print("   Fuel Cut RPM: ");
      //            Serial.print(fuelcut);
      //            Serial.println();
    }

  }
}
// End CAN Bus Function --->


// Run main

void loop()
{

  while (boot_complete != 1)
  {
    static int boot = 0;

    initialize_displays();

    boot_logo(boot);
    if (boot < 4)
    {
      boot++;
    }
    else
    {
      boot = 0;
    }
  }

  // Run Gauges
  if (boot_complete == 1) // Don't display gauges until boot is complete!
  {
    if (gaugeselect == 1)
    {
      test_gauge();
      test_gauge2();
      test_gauge3();
    }
    else if (gaugeselect == 0)
    {
      boost_gauge();
      wideband_gauge_1();
      wideband_gauge_2();
      e85_gauge();
    }
    else if (gaugeselect == 2)
    {
      boost_gauge_test_1();
      boost_gauge_test_2();
      boost_gauge_test_3();
      //      boost_gauge_test_4();
    }
  }
}
